## Kconfig
```kconfig
menuconfig BLINKO
	bool "Blinko optical logger (rolling-shutter camera link)"
	depends on GPIO && HWINFO && FLASH && FLASH_MAP && COUNTER
	help
	  Blink log messages on the board LEDs so a phone camera can decode them.
	  On a fatal error the reason is written to RAM/flash and blinked forever
	  on the fault LEDs ("red LED of death").
	  Needs CONFIG_GPIO, CONFIG_HWINFO, CONFIG_FLASH, CONFIG_FLASH_MAP,
	  CONFIG_COUNTER, a devicetree alias "blinko-timer" pointing at a counter
	  device, led0..led3 aliases and a storage_partition.

if BLINKO

config BLINKO_CHIP_US
	int "Minimum run T of the line code in microseconds (timer period = T / 3)"
	default 60
	help
	  Must be >= 4 camera row times and >= the phone's minimum exposure.
	  iPhone 14: 30 us.

config BLINKO_CHANNELS
	int "LED channels: 3 = RGB streams on led0/led1/led2 (led3 mirrors led0), 1 = same stream on all"
	range 1 3
	default 3

config BLINKO_PILOT_MS
	int "RGB colour-calibration pilot interval (ms)"
	default 30

config BLINKO_FAULT_WEIGHT
	int "FAULT visits per other visit in the death loop (1-4)"
	range 1 4
	default 3
	help
	  Airtime given to the fault reason while the board is dead: 3 means about
	  70 % of the packets carry the FAULT message, so it completes in 1-2 s while
	  STATUS and the last logs still follow.

config BLINKO_BURST_ON_MS
	int "Visible blink: transmit burst length (ms)"
	default 150

config BLINKO_BURST_OFF_MS
	int "Visible blink: dark pause length (ms, 0 = continuous). The death loop always pulses."
	default 50

config BLINKO_FAULT_LED
	int "LED alias index used by the death loop (0 = led0, the red LED)"
	default 0

config BLINKO_PERSIST
	bool "Persist fault records in flash (last page of storage_partition)"
	default y

config BLINKO_ANNOUNCE_BOOT
	bool "Put boot count and reset cause in the STATUS slot at init"
	default y

config BLINKO_AUTO_INIT
	bool "Initialize automatically at boot (SYS_INIT, APPLICATION level)"
	default y

config BLINKO_RAM_RECORD_ADDR
	hex "Address of the reset-surviving RAM record (0 = Zephyr .noinit)"
	default 0
	help
	  Use a fixed high-RAM address when the board's bootloader clears low RAM
	  (Arduino Nano 33 BLE: 0x2003F000).

config BLINKO_NRF_FLASH_IN_FATAL
	bool "Persist the fault record immediately in the fatal handler (nrfx_nvmc)"
	depends on SOC_FAMILY_NORDIC_NRF && NRFX_NVMC
	default y
	help
	  Without this the record is kept in RAM and written to flash at the
	  next boot (portable path).

config BLINKO_LOG_BACKEND
	bool "Zephyr log backend: LOG_ERR()/LOG_WRN()/LOG_INF() lines go to the LEDs"
	depends on LOG && !LOG_MODE_MINIMAL
	select LOG_OUTPUT
	default y
	help
	  Every log line becomes an Blinko message (level mapped, no prefixes).
	  Needs CONFIG_LOG_MODE_DEFERRED (the default); minimal mode has no backends.

config BLINKO_LOG_BACKEND_LEVEL
	int "Highest log level forwarded (1 ERR, 2 WRN, 3 INF, 4 DBG)"
	depends on BLINKO_LOG_BACKEND
	range 1 4
	default 3

config BLINKO_FATAL_HOOK
	bool "Override k_sys_fatal_error_handler with the death loop"
	default y

endif
```
